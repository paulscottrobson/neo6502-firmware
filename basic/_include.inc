;
;	This file is automatically generated.
;
	.include "sources/00data/00data_config.inc"
	.include "sources/00data/01data.inc"
	.include "sources/arithmetic/binary/binary.inc"
	.include "sources/generated/errors.inc"
	.include "sources/generated/kwdconst.inc"
	.include "sources/generated/neo6502.inc"
	.include "sources/support/stack/stack.inc"
	.include "sources/arithmetic/array.asm"
	.include "sources/arithmetic/binary/compare.asm"
	.include "sources/arithmetic/binary/mathint.asm"
	.include "sources/arithmetic/binary/mathstd.asm"
	.include "sources/arithmetic/dereference.asm"
	.include "sources/arithmetic/expression.asm"
	.include "sources/arithmetic/exprutils.asm"
	.include "sources/arithmetic/term.asm"
	.include "sources/arithmetic/unary/alloc.asm"
	.include "sources/arithmetic/unary/asc.asm"
	.include "sources/arithmetic/unary/chr.asm"
	.include "sources/arithmetic/unary/dollar.asm"
	.include "sources/arithmetic/unary/inkey.asm"
	.include "sources/arithmetic/unary/key.asm"
	.include "sources/arithmetic/unary/len.asm"
	.include "sources/arithmetic/unary/peekdeek.asm"
	.include "sources/arithmetic/unary/simple.asm"
	.include "sources/arithmetic/unary/str.asm"
	.include "sources/arithmetic/unary/string.asm"
	.include "sources/arithmetic/unary/substring.asm"
	.include "sources/arithmetic/unary/time.asm"
	.include "sources/arithmetic/unary/val.asm"
	.include "sources/commands/assert.asm"
	.include "sources/commands/clear.asm"
	.include "sources/commands/comment.asm"
	.include "sources/commands/dim.asm"
	.include "sources/commands/goto.asm"
	.include "sources/commands/inputprint.asm"
	.include "sources/commands/let.asm"
	.include "sources/commands/new.asm"
	.include "sources/commands/pokedoke.asm"
	.include "sources/commands/run.asm"
	.include "sources/commands/stop.asm"
	.include "sources/commands/sys.asm"
	.include "sources/commands/undefined.asm"
	.include "sources/editing/editing/delete.asm"
	.include "sources/editing/editing/insert.asm"
	.include "sources/editing/tokenise/helpers/tokconstant.asm"
	.include "sources/editing/tokenise/helpers/tokfind.asm"
	.include "sources/editing/tokenise/helpers/tokidcreate.asm"
	.include "sources/editing/tokenise/helpers/tokidfind.asm"
	.include "sources/editing/tokenise/helpers/tokio.asm"
	.include "sources/editing/tokenise/helpers/toktypes.asm"
	.include "sources/editing/tokenise/tokenise.asm"
	.include "sources/editing/tokenise/workers/tok_decimal.asm"
	.include "sources/editing/tokenise/workers/tok_hexconstant.asm"
	.include "sources/editing/tokenise/workers/tok_identifier.asm"
	.include "sources/editing/tokenise/workers/tok_intconstant.asm"
	.include "sources/editing/tokenise/workers/tok_punctuation.asm"
	.include "sources/editing/tokenise/workers/tok_string.asm"
	.include "sources/generated/errors.asm"
	.include "sources/generated/kwdtext.asm"
	.include "sources/generated/vectors_assembler.asm"
	.include "sources/generated/vectors_binary.asm"
	.include "sources/generated/vectors_extended.asm"
	.include "sources/generated/vectors_standard.asm"
	.include "sources/miscellany/speed.asm"
	.include "sources/miscellany/tokentest.asm"
	.include "sources/structures/call.asm"
	.include "sources/structures/do.asm"
	.include "sources/structures/for.asm"
	.include "sources/structures/gosub.asm"
	.include "sources/structures/if.asm"
	.include "sources/structures/repeat.asm"
	.include "sources/structures/scanforward.asm"
	.include "sources/structures/scanproc.asm"
	.include "sources/structures/while.asm"
	.include "sources/support/errors/errorhandler.asm"
	.include "sources/support/errors/syntax.asm"
	.include "sources/support/stack/bytes.asm"
	.include "sources/support/stack/frames.asm"
	.include "sources/support/stack/location.asm"
	.include "sources/support/stack/setup.asm"
	.include "sources/support/strings/concrete.asm"
	.include "sources/support/strings/stringalloc.asm"

; ************************************************************************************************
; ************************************************************************************************
;
;		Name:		00data_config.inc
;		Purpose:	BASIC memory usage configuration
;		Created:	25th November 2023
;		Reviewed:	No
;		Author:		Paul Robson (paul@robsons.org.uk)
;
; ************************************************************************************************
; ************************************************************************************************

; ************************************************************************************************
;	
;	These can be overridden on the command line. tass64 doesn't support ifdef, god knows why not.
;
; ************************************************************************************************

		.weak
		.endweak

		* = $10
		.dsection zeropage

		* = $200
		.dsection storage

		* = $800 							; BASIC ROM goes here.
		.dsection code

		HIGHMEMORY = $F000
		STACKPAGES = 8 

; ************************************************************************************************
;
;									Changes and Updates
;
; ************************************************************************************************
;
;		Date			Notes
;		==== 			=====
;
; ************************************************************************************************


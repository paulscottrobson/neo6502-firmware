; ************************************************************************************************
; ************************************************************************************************
;
;		Name:		02colours.inc
;		Purpose:	Default Colours
;		Created:	28th Decmber 2023
;		Reviewed:	No
;		Author:		Paul Robson (paul@robsons.org.uk)
;
; ************************************************************************************************
; ************************************************************************************************

; ************************************************************************************************
;
;											Colours
;
; ************************************************************************************************

COL_BLACK = 0
COL_RED = 1
COL_GREEN = 2
COL_YELLOW = 3
COL_BLUE = 4
COL_MAGENTA = 5
COL_CYAN = 6
COL_WHITE = 7
COL_ALT_BLACK = 8
COL_DARK_GREY = 9
COL_DARK_GREEN = 10
COL_ORANGE = 11
COL_DARK_ORANGE = 12
COL_BROWN = 13
COL_PINK = 14
COL_LIGHT_GREY = 15


; ************************************************************************************************
;
;									Changes and Updates
;
; ************************************************************************************************
;
;		Date			Notes
;		==== 			=====
;
; ************************************************************************************************


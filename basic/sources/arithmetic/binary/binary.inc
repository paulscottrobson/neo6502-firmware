; ************************************************************************************************
; ************************************************************************************************
;
;		Name:		binary.inc
;		Purpose:	Helper Macros
;		Created:	1st December 2023
;		Reviewed:	No
;		Author:		Paul Robson (paul@robsons.org.uk)
;
; ************************************************************************************************
; ************************************************************************************************

binop 	.macro

		lda 	XSNumber0,x
		\1 		XSNumber0+1,x
		sta 	XSNumber0,x

		lda 	XSNumber1,x
		\1 		XSNumber1+1,x
		sta 	XSNumber1,x
				
		lda 	XSNumber2,x
		\1 		XSNumber2+1,x
		sta 	XSNumber2,x
				
		lda 	XSNumber3,x
		\1 		XSNumber3+1,x
		sta 	XSNumber3,x

		.endm
						
; ************************************************************************************************
;
;									Changes and Updates
;
; ************************************************************************************************
;
;		Date			Notes
;		==== 			=====
;
; ************************************************************************************************


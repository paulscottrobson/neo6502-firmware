;
;	This file is automatically generated.
;
KWD_PLUS                           = $20 ; +
KWD_MINUS                          = $21 ; -
KWD_ASTERISK                       = $22 ; *
KWD_SLASH                          = $23 ; /
KWD_GREATERGREATER                 = $24 ; >>
KWD_LESSLESS                       = $25 ; <<
KWD_PERCENT                        = $26 ; %
KWD_BACKSLASH                      = $27 ; \
KWD_AMPERSAND                      = $28 ; &
KWD_VBAR                           = $29 ; |
KWD_HAT                            = $2a ; ^
KWD_GREATER                        = $2b ; >
KWD_GREATEREQUAL                   = $2c ; >=
KWD_LESS                           = $2d ; <
KWD_LESSEQUAL                      = $2e ; <=
KWD_LESSGREATER                    = $2f ; <>
KWD_EQUAL                          = $30 ; =
KWD_SYS_STR                        = $80 ; !!str
KWD_DOLLAR                         = $81 ; $
KWD_LPAREN                         = $82 ; (
KWD_RANDLPAREN                     = $83 ; rand(
KWD_RNDLPAREN                      = $84 ; rnd(
KWD_JOYPADLPAREN                   = $85 ; joypad(
KWD_INTLPAREN                      = $86 ; int(
KWD_TIMELPAREN                     = $87 ; time(
KWD_EVENTLPAREN                    = $88 ; event(
KWD_INKEYDOLLARLPAREN              = $89 ; inkey$(
KWD_ASCLPAREN                      = $8a ; asc(
KWD_CHRDOLLARLPAREN                = $8b ; chr$(
KWD_POINTLPAREN                    = $8c ; point(
KWD_LENLPAREN                      = $8d ; len(
KWD_ABSLPAREN                      = $8e ; abs(
KWD_SGNLPAREN                      = $8f ; sgn(
KWD_HITLPAREN                      = $90 ; hit(
KWD_SPOINTLPAREN                   = $91 ; spoint(
KWD_MIDDOLLARLPAREN                = $92 ; mid$(
KWD_LEFTDOLLARLPAREN               = $93 ; left$(
KWD_RIGHTDOLLARLPAREN              = $94 ; right$(
KWD_TRUE                           = $95 ; true
KWD_FALSE                          = $96 ; false
KWD_SYS_UN4                        = $97 ; !!un4
KWD_SYS_UN5                        = $98 ; !!un5
KWD_SYS_UN6                        = $99 ; !!un6
KWD_SYS_UN7                        = $9a ; !!un7
KWD_KEYLPAREN                      = $9b ; key(
KWD_PEEKLPAREN                     = $9c ; peek(
KWD_DEEKLPAREN                     = $9d ; deek(
KWD_ALLOCLPAREN                    = $9e ; alloc(
KWD_MAXLPAREN                      = $9f ; max(
KWD_MINLPAREN                      = $a0 ; min(
KWD_WHILE                          = $b0 ; while
KWD_WEND                           = $b1 ; wend
KWD_IF                             = $b2 ; if
KWD_ENDIF                          = $b3 ; endif
KWD_DO                             = $b4 ; do
KWD_LOOP                           = $b5 ; loop
KWD_REPEAT                         = $b6 ; repeat
KWD_UNTIL                          = $b7 ; until
KWD_PROC                           = $b8 ; proc
KWD_ENDPROC                        = $b9 ; endproc
KWD_FOR                            = $ba ; for
KWD_NEXT                           = $bb ; next
KWD_CASE                           = $bc ; case
KWD_ENDCASE                        = $bd ; endcase
KWD_SYS_UN1                        = $be ; !!un1
KWD_THEN                           = $bf ; then
KWD_SYS_END                        = $c0 ; !!end
KWD_SYS_SH1                        = $c1 ; !!sh1
KWD_SYS_SH2                        = $c2 ; !!sh2
KWD_SYS_DEC                        = $c3 ; !!dec
KWD_TO                             = $c4 ; to
KWD_LET                            = $c5 ; let
KWD_PRINT                          = $c6 ; print
KWD_INPUT                          = $c7 ; input
KWD_SYS                            = $c8 ; sys
KWD_EXIT                           = $c9 ; exit
KWD_COMMA                          = $ca ; ,
KWD_SEMICOLON                      = $cb ; ;
KWD_COLON                          = $cc ; :
KWD_SQUOTE                         = $cd ; '
KWD_RPAREN                         = $ce ; )
KWD_READ                           = $cf ; read
KWD_DATA                           = $d0 ; data
KWD_ELSE                           = $d1 ; else
KWD_WHEN                           = $d2 ; when
KWD_DOWNTO                         = $d3 ; downto
KWD_POKE                           = $d4 ; poke
KWD_DOKE                           = $d5 ; doke
KWD_LOCAL                          = $d6 ; local
KWD_CALL                           = $d7 ; call
KWD_HASH                           = $d8 ; #
KWD_PERIOD                         = $d9 ; .
KWD_LINE                           = $da ; line
KWD_RECT                           = $db ; rect
KWD_MOVE                           = $dc ; move
KWD_PLOT                           = $dd ; plot
KWD_ELLIPSE                        = $de ; ellipse
KWD_TEXT                           = $df ; text
KWD_IMAGE                          = $e0 ; image
KWD_SPRITE                         = $e1 ; sprite
KWD_FROM                           = $e2 ; from
KWD_LSQ                            = $e3 ; [
KWD_RSQ                            = $e4 ; ]
KWD_AT                             = $e5 ; @
KWD_TILEDRAW                       = $e6 ; tiledraw
KWD_REF                            = $e7 ; ref
KWD_CLEAR                          = $180 ; clear
KWD_NEW                            = $181 ; new
KWD_RUN                            = $182 ; run
KWD_STOP                           = $183 ; stop
KWD_END                            = $184 ; end
KWD_ASSERT                         = $185 ; assert
KWD_LIST                           = $186 ; list
KWD_SAVE                           = $187 ; save
KWD_LOAD                           = $188 ; load
KWD_CAT                            = $189 ; cat
KWD_GOSUB                          = $18a ; gosub
KWD_GOTO                           = $18b ; goto
KWD_RETURN                         = $18c ; return
KWD_RESTORE                        = $18d ; restore
KWD_DIM                            = $18e ; dim
KWD_FKEY                           = $18f ; fkey
KWD_CLS                            = $190 ; cls
KWD_INK                            = $191 ; ink
KWD_FRAME                          = $192 ; frame
KWD_SOLID                          = $193 ; solid
KWD_BY                             = $194 ; by
KWD_WHO                            = $195 ; who
KWD_PALETTE                        = $196 ; palette
KWD_DRAW                           = $197 ; draw
KWD_HIDE                           = $198 ; hide
KWD_FLIP                           = $199 ; flip
KWD_SOUND                          = $19a ; sound
KWD_SFX                            = $19b ; sfx
KWD_ANCHOR                         = $19c ; anchor
KWD_GLOAD                          = $19d ; gload
KWD_DEFCHR                         = $19e ; defchr
KWD_LEFT                           = $19f ; left
KWD_RIGHT                          = $1a0 ; right
KWD_FORWARD                        = $1a1 ; forward
KWD_TURTLE                         = $1a2 ; turtle
KWD_SWEET                          = $1a3 ; sweet
KWD_TILEMAP                        = $1a4 ; tilemap
KWD_PENUP                          = $1a5 ; penup
KWD_PENDOWN                        = $1a6 ; pendown
KWD_FAST                           = $1a7 ; fast
KWD_HOME                           = $1a8 ; home
KWD_LOCALE                         = $1a9 ; locale
KWD_CURSOR                         = $1aa ; cursor
KWD_RENUMBER                       = $1ab ; renumber
KWD_DELETE                         = $1ac ; delete
KWD_EDITOR                         = $1ad ; editor
KWD_MON                            = $1ae ; mon
KWD_ADC                            = $280 ; adc
KWD_AND                            = $281 ; and
KWD_ASL                            = $282 ; asl
KWD_BCC                            = $283 ; bcc
KWD_BCS                            = $284 ; bcs
KWD_BEQ                            = $285 ; beq
KWD_BIT                            = $286 ; bit
KWD_BMI                            = $287 ; bmi
KWD_BNE                            = $288 ; bne
KWD_BPL                            = $289 ; bpl
KWD_BRA                            = $28a ; bra
KWD_BRK                            = $28b ; brk
KWD_BVC                            = $28c ; bvc
KWD_BVS                            = $28d ; bvs
KWD_CLC                            = $28e ; clc
KWD_CLD                            = $28f ; cld
KWD_CLI                            = $290 ; cli
KWD_CLV                            = $291 ; clv
KWD_CMP                            = $292 ; cmp
KWD_CPX                            = $293 ; cpx
KWD_CPY                            = $294 ; cpy
KWD_DEC                            = $295 ; dec
KWD_DEX                            = $296 ; dex
KWD_DEY                            = $297 ; dey
KWD_EOR                            = $298 ; eor
KWD_INC                            = $299 ; inc
KWD_INX                            = $29a ; inx
KWD_INY                            = $29b ; iny
KWD_JMP                            = $29c ; jmp
KWD_JSR                            = $29d ; jsr
KWD_LDA                            = $29e ; lda
KWD_LDX                            = $29f ; ldx
KWD_LDY                            = $2a0 ; ldy
KWD_LSR                            = $2a1 ; lsr
KWD_NOP                            = $2a2 ; nop
KWD_ORA                            = $2a3 ; ora
KWD_PHA                            = $2a4 ; pha
KWD_PHP                            = $2a5 ; php
KWD_PHX                            = $2a6 ; phx
KWD_PHY                            = $2a7 ; phy
KWD_PLA                            = $2a8 ; pla
KWD_PLP                            = $2a9 ; plp
KWD_PLX                            = $2aa ; plx
KWD_PLY                            = $2ab ; ply
KWD_ROL                            = $2ac ; rol
KWD_ROR                            = $2ad ; ror
KWD_RTI                            = $2ae ; rti
KWD_RTS                            = $2af ; rts
KWD_SBC                            = $2b0 ; sbc
KWD_SEC                            = $2b1 ; sec
KWD_SED                            = $2b2 ; sed
KWD_SEI                            = $2b3 ; sei
KWD_STA                            = $2b4 ; sta
KWD_STX                            = $2b5 ; stx
KWD_STY                            = $2b6 ; sty
KWD_STZ                            = $2b7 ; stz
KWD_TAX                            = $2b8 ; tax
KWD_TAY                            = $2b9 ; tay
KWD_TRB                            = $2ba ; trb
KWD_TSB                            = $2bb ; tsb
KWD_TSX                            = $2bc ; tsx
KWD_TXA                            = $2bd ; txa
KWD_TXS                            = $2be ; txs
KWD_TYA                            = $2bf ; tya
KWD_SET                            = $2c0 ; set
KWD_LD                             = $2c1 ; ld
KWD_ST                             = $2c2 ; st
KWD_LDD                            = $2c3 ; ldd
KWD_STD                            = $2c4 ; std
KWD_POP                            = $2c5 ; pop
KWD_STP                            = $2c6 ; stp
KWD_ADD                            = $2c7 ; add
KWD_SUB                            = $2c8 ; sub
KWD_POPD                           = $2c9 ; popd
KWD_CPR                            = $2ca ; cpr
KWD_INR                            = $2cb ; inr
KWD_DCR                            = $2cc ; dcr
KWD_RTN                            = $2cd ; rtn
KWD_BR                             = $2ce ; br
KWD_BNC                            = $2cf ; bnc
KWD_BC                             = $2d0 ; bc
KWD_BP                             = $2d1 ; bp
KWD_BM                             = $2d2 ; bm
KWD_BZ                             = $2d3 ; bz
KWD_BNZ                            = $2d4 ; bnz
KWD_BM1                            = $2d5 ; bm1
KWD_BNM1                           = $2d6 ; bnm1
KWD_BK                             = $2d7 ; bk
KWD_RS                             = $2d8 ; rs
KWD_BS                             = $2d9 ; bs
KWD_SINLPAREN                      = $2e0 ; sin(
KWD_COSLPAREN                      = $2e1 ; cos(
KWD_TANLPAREN                      = $2e2 ; tan(
KWD_ATANLPAREN                     = $2e3 ; atan(
KWD_LOGLPAREN                      = $2e4 ; log(
KWD_EXPLPAREN                      = $2e5 ; exp(
KWD_VALLPAREN                      = $2e6 ; val(
KWD_STRDOLLARLPAREN                = $2e7 ; str$(
KWD_ISVALLPAREN                    = $2e8 ; isval(
KWD_SQRLPAREN                      = $2e9 ; sqr(
KWD_PAGE                           = $2ea ; page
KWD_SPRITEXLPAREN                  = $2eb ; spritex(
KWD_SPRITEYLPAREN                  = $2ec ; spritey(
KWD_NOTESLPAREN                    = $2ed ; notes(
KWD_HIMEM                          = $2ee ; himem
KWD_VBLANKSLPAREN                  = $2ef ; vblanks(

;
;	This file is automatically generated.
;
error_syntax .macro
	lda	#1
	jmp	ErrorHandler
	.endm

error_type .macro
	lda	#2
	jmp	ErrorHandler
	.endm

error_divzero .macro
	lda	#3
	jmp	ErrorHandler
	.endm

error_range .macro
	lda	#4
	jmp	ErrorHandler
	.endm

error_assert .macro
	lda	#5
	jmp	ErrorHandler
	.endm

error_break .macro
	lda	#6
	jmp	ErrorHandler
	.endm

error_stop .macro
	lda	#7
	jmp	ErrorHandler
	.endm

error_structure .macro
	lda	#8
	jmp	ErrorHandler
	.endm

error_stack .macro
	lda	#9
	jmp	ErrorHandler
	.endm

error_string .macro
	lda	#10
	jmp	ErrorHandler
	.endm

error_argument .macro
	lda	#11
	jmp	ErrorHandler
	.endm

error_stringsize .macro
	lda	#12
	jmp	ErrorHandler
	.endm

error_reference .macro
	lda	#13
	jmp	ErrorHandler
	.endm

error_line .macro
	lda	#14
	jmp	ErrorHandler
	.endm

error_unimp .macro
	lda	#15
	jmp	ErrorHandler
	.endm

error_unknown .macro
	lda	#16
	jmp	ErrorHandler
	.endm

error_memory .macro
	lda	#17
	jmp	ErrorHandler
	.endm

error_file .macro
	lda	#18
	jmp	ErrorHandler
	.endm

error_data .macro
	lda	#19
	jmp	ErrorHandler
	.endm

error_label .macro
	lda	#20
	jmp	ErrorHandler
	.endm

error_array .macro
	lda	#21
	jmp	ErrorHandler
	.endm


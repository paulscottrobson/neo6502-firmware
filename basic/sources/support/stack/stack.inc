; ************************************************************************************************
; ************************************************************************************************
;
;		Name:		stack.inc
;		Purpose:	Stack Constants
;		Created:	5th December 2023
;		Reviewed:   No
;		Author:		Paul Robson (paul@robsons.org.uk)
;
; ************************************************************************************************
; ************************************************************************************************

; ************************************************************************************************
;
;								Marker IDs for stacked values
;
;
;					Bits 7..4 ID Bits 0..3 allocate 2 x for stack space
;
;	$Fx is reserved.
;
; ************************************************************************************************

STK_REPEAT = $12 			
STK_WHILE = $22
STK_DO = $32
STK_FOR = $47
STK_CALL = $52
STK_GOSUB = $62

STK_LOCALINFO = $0F
STK_LOCALN = $01
STK_LOCALS = $02
STK_REFPARAM = $03

; ************************************************************************************************
;
;									Changes and Updates
;
; ************************************************************************************************
;
;		Date			Notes
;		==== 			=====
;
; ************************************************************************************************
